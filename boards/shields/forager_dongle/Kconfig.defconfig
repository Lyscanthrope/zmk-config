## boards/shields/forager_dongle/Kconfig.defconfig
```kconfig
#if SHIELD_FORAGER_LEFT

#config ZMK_KEYBOARD_NAME
#    default "Forager"

#config ZMK_SPLIT_ROLE_CENTRAL
#    default y

#config ZMK_STUDIO
#    default y

#endif

if SHIELD_FORAGER_LEFT || SHIELD_FORAGER_RIGHT

config ZMK_SPLIT
    default y

endif

if SHIELD_FORAGER_CENTRAL

if ZMK_DISPLAY

config I2C
    default y

config SSD1306
    default y

choice ZMK_DISPLAY_WORK_QUEUE
    default ZMK_DISPLAY_WORK_QUEUE_DEDICATED
endchoice

endif

if SSD1306

config LV_Z_VDB_SIZE
    default 64

config LV_DPI_DEF
    default 148

config LV_Z_BITS_PER_PIXEL
    default 1

choice LV_COLOR_DEPTH
    default LV_COLOR_DEPTH_1
endchoice

endif

# Max 16 characters in keyboard name
config ZMK_KEYBOARD_NAME
    default "Forager_w_dngl"

config ZMK_SPLIT_ROLE_CENTRAL
    default y

config ZMK_SPLIT
    default y

# Set this to the number of peripherals your dongle will have.
# For a unibody, this would be 1. If you have left and right halves, set it to 2, etc.
config ZMK_SPLIT_BLE_CENTRAL_PERIPHERALS
    default 2

# Set this to ZMK_SPLIT_BLE_CENTRAL_PERIPHERALS + your desired number of BT profiles (default is 5)
config BT_MAX_CONN
    default 6

# Set this to the same number as BT_MAX_CONN
config BT_MAX_PAIRED
    default 6

endif
```

## boards/shields/forager_dongle/Kconfig.shield
```kconfig
# SPDX-License-Identifier: MIT


config SHIELD_FORAGER_CENTRAL
    def_bool $(shields_list_contains,forager_central)

config SHIELD_FORAGER_LEFT
    def_bool $(shields_list_contains,forager_left)

config SHIELD_FORAGER_RIGHT
    def_bool $(shields_list_contains,forager_right)
```

## config/west.yml
```yaml
manifest:
  remotes:
    - name: zmkfirmware
      url-base: https://github.com/zmkfirmware
    - name: carrefinho                            # <---
      url-base: https://github.com/carrefinho     # <---
    - name: caksoylar                             # <---
      url-base: https://github.com/caksoylar      # <---
    - name: tokyo2006
      url-base: https://github.com/tokyo2006
    - name: englmaxi
      url-base: https://github.com/englmaxi
  projects:
    - name: zmk
      remote: zmkfirmware
      revision: main
      import: app/west.yml
    - name: forager-zmk-module                    # <---
      remote: carrefinho                          # <---
      revision: main                              # <---
    - name: zmk-rgbled-widget                     # <---
      remote: caksoylar                           # <---
      revision: main                              # <---
    # - name: prospector-zmk-module                 # <--- and these
    #   remote: tokyo2006                          # <---
    #   revision: change_spi2
    - name: zmk-dongle-display
      remote: englmaxi
      revision: main
  self:
    path: config
```
